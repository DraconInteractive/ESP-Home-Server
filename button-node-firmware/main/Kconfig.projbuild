## button-node-firmware/main/Kconfig.projbuild
```kconfig
menu "Button node"

config BUTTON_NODE_WIFI_SSID
    string "Wi-Fi SSID"
    default ""
    help
        Home Wi-Fi network SSID used by the XIAO ESP32-C3 button node.

config BUTTON_NODE_WIFI_PASSWORD
    string "Wi-Fi password"
    default ""
    help
        Home Wi-Fi password. Leave empty for an open network.

config BUTTON_NODE_SERVER_URL
    string "Command server base URL"
    default "http://192.168.4.20:8080"
    help
        Base URL for the local command server, without a trailing slash.

config BUTTON_NODE_BUTTON_GPIO
    int "Button GPIO"
    range 0 21
    default 10
    help
        GPIO used for the button. Seeed XIAO ESP32-C3 D10 maps to GPIO10.

config BUTTON_NODE_ACTIVE_LOW
    bool "Button is active low"
    default y
    help
        Enable when the button connects the GPIO to GND and uses the internal pull-up.

endmenu
```

## button-node-firmware/sdkconfig.defaults
```kconfig
CONFIG_IDF_TARGET="esp32c3"
CONFIG_ESPTOOLPY_FLASHMODE_DIO=y
CONFIG_ESPTOOLPY_FLASHFREQ_80M=y
CONFIG_FREERTOS_HZ=1000
```

## c6-lcd-147-firmware/main/Kconfig.projbuild
```kconfig
menu "Waveshare ESP32-C6 LCD 1.47"

config C6_LCD147_WIFI_SSID
    string "Wi-Fi SSID"
    default ""
    help
        Home Wi-Fi network SSID used by the Waveshare ESP32-C6-LCD-1.47 node.

config C6_LCD147_WIFI_PASSWORD
    string "Wi-Fi password"
    default ""
    help
        Home Wi-Fi password. Leave empty for an open network.

config C6_LCD147_SERVER_URL
    string "Command server base URL"
    default "http://192.168.4.20:8080"
    help
        Base URL for the local command server, without a trailing slash.

endmenu
```

## esp-eye-firmware/main/Kconfig.projbuild
```kconfig
menu "ESP-EYE Registration"

config ESP_EYE_WIFI_SSID
    string "Wi-Fi SSID"
    default ""
    help
        Wi-Fi network SSID for the ESP-EYE.

config ESP_EYE_WIFI_PASSWORD
    string "Wi-Fi password"
    default ""
    help
        Wi-Fi network password. Leave empty for an open network.

config ESP_EYE_COMMAND_SERVER_URL
    string "Command server base URL"
    default "http://192.168.4.20:8080"
    help
        Base URL for the local command server.

config ESP_EYE_REGISTER_INTERVAL_SECONDS
    int "Registration refresh interval seconds"
    default 30
    range 5 3600
    help
        How often the ESP-EYE refreshes its server registration.

endmenu
```

## esp-eye-firmware/sdkconfig.defaults
```kconfig
CONFIG_ESPTOOLPY_FLASHSIZE_4MB=y
CONFIG_ESPTOOLPY_FLASHSIZE="4MB"
CONFIG_PARTITION_TABLE_CUSTOM=y
CONFIG_PARTITION_TABLE_CUSTOM_FILENAME="partitions.csv"
CONFIG_PARTITION_TABLE_FILENAME="partitions.csv"
CONFIG_SPIRAM=y
CONFIG_SPIRAM_MODE_QUAD=y
CONFIG_SPIRAM_TYPE_AUTO=y
CONFIG_SPIRAM_SPEED_40M=y
CONFIG_SPIRAM_USE_MALLOC=y
CONFIG_ESP_DEFAULT_CPU_FREQ_MHZ_240=y
CONFIG_FREERTOS_HZ=1000
CONFIG_ESP_MAIN_TASK_STACK_SIZE=8192
```

## nesso-n1-firmware/main/Kconfig.projbuild
```kconfig
menu "Arduino Nesso N1"

config NESSO_N1_WIFI_SSID
    string "Wi-Fi SSID"
    default ""
    help
        Home Wi-Fi network SSID used by the Arduino Nesso N1 node.

config NESSO_N1_WIFI_PASSWORD
    string "Wi-Fi password"
    default ""
    help
        Home Wi-Fi password. Leave empty for an open network.

config NESSO_N1_SERVER_URL
    string "Command server base URL"
    default "http://192.168.4.20:8080"
    help
        Base URL for the local command server, without a trailing slash.

config NESSO_N1_RELAY_ENROLL_TOKEN
    string "Relay device enrollment token"
    default ""
    help
        Optional bearer token used to enroll this device with the public relay.
        Leave empty when talking directly to the local command server. When set,
        the device stores the generated device secret in NVS and uses it for
        future relay registration and button requests.

endmenu
```

## nesso-n1-firmware/sdkconfig.defaults
```kconfig
CONFIG_IDF_TARGET="esp32c6"
CONFIG_ESPTOOLPY_FLASHMODE_DIO=y
CONFIG_ESPTOOLPY_FLASHFREQ_80M=y
CONFIG_ESPTOOLPY_FLASHSIZE_16MB=y
CONFIG_PARTITION_TABLE_CUSTOM=y
CONFIG_PARTITION_TABLE_CUSTOM_FILENAME="partitions.csv"
CONFIG_PARTITION_TABLE_FILENAME="partitions.csv"
CONFIG_FREERTOS_HZ=1000
```
